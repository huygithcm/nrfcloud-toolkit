## fw-swap/Kconfig/boards/Kconfig.defconfig
```kconfig
# Load Zephyr board defconfig descriptions.
osource "C:/ncs/v3.2.2/zephyr/boards/nordic/nrf9160dk/Kconfig.defconfig"
```

## fw-swap/Kconfig/boards/Kconfig.sysbuild
```kconfig
# Load Sysbuild board Kconfig descriptions.
osource "C:/ncs/v3.2.2/zephyr/boards/nordic/nrf9160dk/Kconfig.sysbuild"
```

## product_build/Kconfig/boards/Kconfig.nrf9160dk
```kconfig
# Load board Kconfig descriptions.
osource "C:/ncs/v3.2.2/zephyr/boards/nordic/nrf9160dk/Kconfig.nrf9160dk"
```

## product_build/firmware_dev/Kconfig/boards/Kconfig
```kconfig
# Load Zephyr board Kconfig descriptions.
osource "C:/ncs/v3.2.2/zephyr/boards/nordic/nrf9160dk/Kconfig"
config BOARD_REVISION_0_14_0
	def_bool y
```
